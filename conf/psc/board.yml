## conf/psc/board.yml
```yaml
board:
  name: The oca board
  members:
    - dreispt
    - etobella
    - ivs-cetmix
    - jelenapoblet
    - jgrandguillaume
    - OSevangelist
    - sbidoul
    - sebastienbeau
    - thomaspaulb
  representatives:
    - jgrandguillaume
```
